## bt541/Kconfig
```kconfig
config MSM_BT_POWER
	tristate "Pong541 MSM_BT_POWER"
config QCOM_AOSS_QMP
	tristate "Pong541 QCOM_AOSS_QMP"
config PINCTRL_MSM
	tristate "Pong541 PINCTRL_MSM"
config FMD_ENABLE
	bool "Pong541 FMD_ENABLE"
config MSM_BT_OOBS
	bool "Pong541 MSM_BT_OOBS"
config BT_HW_SECURE_DISABLE
	bool "Pong541 BT_HW_SECURE_DISABLE"
config BT_SLIM
	bool "Pong541 BT_SLIM"
```

## btCLS33/defconfig
```kconfig
CONFIG_MSM_BT_POWER=m
CONFIG_QCOM_AOSS_QMP=m
CONFIG_PINCTRL_MSM=m
# CONFIG_FMD_ENABLE is not set
# CONFIG_MSM_BT_OOBS is not set
# CONFIG_BT_HW_SECURE_DISABLE is not set
# CONFIG_BT_SLIM is not set
```

## cfg468/defconfig
```kconfig
CONFIG_CFG80211=m
# CONFIG_CFG80211_DEBUGFS is not set
CONFIG_CFG80211_REQUIRE_SIGNED_REGDB=y
CONFIG_CFG80211_USE_KERNEL_REGDB_KEYS=y
```

## cnssCLS32/Kconfig
```kconfig
config QCOM_Q6V5_COMMON
	tristate "Pong407 QCOM_Q6V5_COMMON"
config QCOM_Q6V5_PAS
	tristate "Pong407 QCOM_Q6V5_PAS"
config QCOM_RPROC_COMMON
	tristate "Pong407 QCOM_RPROC_COMMON"
config QCOM_SYSMON
	tristate "Pong407 QCOM_SYSMON"
config QCOM_PIL_INFO
	tristate "Pong407 QCOM_PIL_INFO"
config QCOM_RAMDUMP
	tristate "Pong407 QCOM_RAMDUMP"
config RPMSG_QCOM_GLINK
	tristate "Pong407 RPMSG_QCOM_GLINK"
config RPMSG_QCOM_GLINK_SMEM
	tristate "Pong407 RPMSG_QCOM_GLINK_SMEM"
config QCOM_PDR_HELPERS
	tristate "Pong407 QCOM_PDR_HELPERS"
config QCOM_QMI_HELPERS
	tristate "Pong407 QCOM_QMI_HELPERS"
config QTI_PMIC_GLINK
	tristate "Pong407 QTI_PMIC_GLINK"
config QTI_BATTERY_CHARGER
	tristate "Pong407 QTI_BATTERY_CHARGER"
config BT_POWER
	tristate "Pong407 BT_POWER"
config CNSS2
	tristate "Pong407 CNSS2"
config CNSS2_QMI
	bool "Pong407 CNSS2_QMI"
config CNSS_OUT_OF_TREE
	bool "Pong407 CNSS_OUT_OF_TREE"
config CNSS_UTILS
	tristate "Pong407 CNSS_UTILS"
config RPMSG_QCOM_SMD
	bool "Pong407 RPMSG_QCOM_SMD"

config PCI_MSM
	tristate "Pong407 vendor PCIe"
config MHI_BUF_LEN
	int "MHI buffer size from original66 CNSS2 Kconfig"
	default 16384
config CNSS_QMI_SVC
	tristate "WLAN firmware QMI"
config CNSS_PLAT_IPC_QMI_SVC
	tristate "WLAN platform IPC QMI"

# SPDX-License-Identifier: GPL-2.0-only
config QTEE_SHM_BRIDGE
    bool
config QCOM_TZMEM_LOW_MEMORY
    bool
config QCOM_TZMEM_FFA
    bool
config SCSI_UFS_CRYPTO_QTI
    bool
config MSM_QMP
    tristate
config MSM_TMECOM_QMP
    tristate
config PONG618_VENDOR_FOUNDATION
    tristate "Pong vendor foundation source port"
    select QCOM_SCM
    select QCOM_TZMEM
    select QCOM_COMMAND_DB
    select QCOM_AOSS_QMP
    select QCOM_SMEM
    select QCOM_INLINE_CRYPTO_ENGINE
    select QTEE_SHM_BRIDGE
    select SCSI_UFS_CRYPTO_QTI
    select MSM_QMP
    select MSM_TMECOM_QMP

config QCOM_MDT_LOADER
	tristate "MDT firmware loader"
config RPROC_SSR_NOTIF_TIMEOUT
	int "RPROC_SSR_NOTIF_TIMEOUT"
	default 20000
config RPROC_SYSMON_NOTIF_TIMEOUT
	int "RPROC_SYSMON_NOTIF_TIMEOUT"
	default 20000
config RPROC_SYSMON_SHUTDOWN_NOTIF_TIMEOUT
	int "RPROC_SYSMON_SHUTDOWN_NOTIF_TIMEOUT"
	default 10000

config PDR_INDICATION_NOTIF_TIMEOUT
	int "PDR timeout from waipio66 config"
	default 9000

config MHI_BUS
	tristate "Vendor66 MHI bus"
config MHI_BUS_MISC
	bool "Vendor MHI misc"
config MHI_BUS_DEBUG
	bool "Vendor MHI debugging"
config QRTR_SMD
	tristate "QRTR over RPMsg"

config PONG407_PCIE_CLOCK_REGISTER_DUMP
	bool "Requires separately verified Qualcomm clock register dumper"
	default n
```

## display108/Kconfig
```kconfig
# SPDX-License-Identifier: GPL-2.0-only
config DRM_MSM
	tristate
config DRM_MSM_DSI
	bool
	default y
config DRM_MSM_REGISTER_LOGGING
	bool
	default y
config DRM_MSM_SDE
	bool
	default y
config DRM_SDE_RSC
	bool
	default y
config QCOM_MDSS_PLL
	bool
	default y
config DSI_PARSER
	bool
	default y

config QCOM_IOMMU_UTIL
	tristate
	default m

config QCOM_SECURE_BUFFER
	tristate
	default m

config QCOM_LAZY_MAPPING
	tristate
	default m

config QTI_IOMMU_SUPPORT
	bool
	default y

config IOMMU_IO_PGTABLE_FAST
	bool
	default y

config ARM_SMMU_CONTEXT_FAULT_RETRY
	bool
	default y

config QCOM_LLCC
	tristate
	default m

config QCOM_PANEL_EVENT_NOTIFIER
	tristate
	default m

config QTEE_SHM_BRIDGE
	bool
	default y

config DRM_SDE_WB
 bool
 default y
```

## display108/scm76/Kconfig
```kconfig
# SPDX-License-Identifier: GPL-2.0-only
config QTEE_SHM_BRIDGE
    bool
config QCOM_TZMEM_LOW_MEMORY
    bool
config QCOM_TZMEM_FFA
    bool
config SCSI_UFS_CRYPTO_QTI
    bool
config MSM_QMP
    tristate
config MSM_TMECOM_QMP
    tristate
config PONG618_VENDOR_FOUNDATION
    tristate "Pong vendor foundation source port"
    select QCOM_SCM
    select QCOM_TZMEM
    select QCOM_COMMAND_DB
    select QCOM_AOSS_QMP
    select QCOM_SMEM
    select QCOM_INLINE_CRYPTO_ENGINE
    select QTEE_SHM_BRIDGE
    select SCSI_UFS_CRYPTO_QTI
    select MSM_QMP
    select MSM_TMECOM_QMP
```

## display108/smmu87-defconfig
```kconfig
CONFIG_QCOM_LLCC=y
CONFIG_QCOM_KGSL=y
CONFIG_QCOM_MDT_LOADER=y
CONFIG_QCOM_KGSL_IDLE_TIMEOUT=80
CONFIG_QCOM_KGSL_SORT_POOL=y
CONFIG_QCOM_KGSL_CONTEXT_DEBUG=y
CONFIG_QCOM_KGSL_IOCOHERENCY_DEFAULT=y
CONFIG_QCOM_ADRENO_DEFAULT_GOVERNOR="msm-adreno-tz"
CONFIG_QCOM_IOMMU_UTIL=m
CONFIG_QCOM_SECURE_BUFFER=m
CONFIG_QCOM_LAZY_MAPPING=m
CONFIG_ARM_SMMU=m
CONFIG_ARM_SMMU_QCOM=m
CONFIG_QTI_IOMMU_SUPPORT=y
CONFIG_IOMMU_IO_PGTABLE_FAST=y
CONFIG_ARM_SMMU_CONTEXT_FAULT_RETRY=y
CONFIG_QCOM_SMEM=m
CONFIG_QCOM_SOCINFO=m
CONFIG_QCOM_MEM_BUF_DEV=m
# CONFIG_QCOM_MEM_BUF is not set
# CONFIG_QCOM_MEM_BUF_DEV_GH is not set
# CONFIG_QCOM_MEM_BUF_GH is not set
# CONFIG_QCOM_MEM_BUF_MSGQ is not set
# CONFIG_QCOM_MEM_BUF_IPA_RESERVE is not set
CONFIG_PONG618_MEMBUF_EXPORTER=m
```

## display76/defconfig
```kconfig
CONFIG_DEBUG_FS=y
CONFIG_DRM_MSM=m
CONFIG_DRM_MSM_DSI=y
CONFIG_DRM_MSM_REGISTER_LOGGING=y
CONFIG_DRM_MSM_SDE=y
CONFIG_DRM_SDE_RSC=y
CONFIG_QCOM_MDSS_PLL=y
CONFIG_SYNC_FILE=y
CONFIG_THERMAL_OF=y
CONFIG_DSI_PARSER=y

CONFIG_QCOM_IOMMU_UTIL=m
CONFIG_QCOM_SECURE_BUFFER=m
CONFIG_QCOM_LAZY_MAPPING=m
CONFIG_QTI_IOMMU_SUPPORT=y
CONFIG_IOMMU_IO_PGTABLE_FAST=y
CONFIG_ARM_SMMU_CONTEXT_FAULT_RETRY=y

CONFIG_QCOM_LLCC=m

CONFIG_QCOM_PANEL_EVENT_NOTIFIER=m

CONFIG_QTEE_SHM_BRIDGE=y

# Primary Pong SDE/DSI profile: do not inherit native multi-platform MSM drivers.
# CONFIG_DRM_MSM_MDP4 is not set
# CONFIG_DRM_MSM_MDP5 is not set
# CONFIG_DRM_MSM_DPU is not set
# CONFIG_DRM_MSM_DP is not set
# CONFIG_DRM_MSM_HDMI is not set
# CONFIG_DRM_MSM_HDMI_HDCP is not set
# CONFIG_DRM_MSM_MDSS is not set
```

## foundation/Kconfig
```kconfig
# SPDX-License-Identifier: GPL-2.0-only
config PONG618_FOUNDATION
    tristate "Pong 6.18 native foundation build control"
    select QCOM_SCM
    select QCOM_TZMEM
    select QCOM_COMMAND_DB
    select QCOM_RPMH
    select QCOM_SMEM
    select HWSPINLOCK_QCOM
```

## heaps269/Kconfig
```kconfig
config QCOM_DMABUF_HEAPS_CMA
    bool
config QCOM_SECURE_BUFFER
    tristate
config PONG_HEAPS269
    tristate "Pong real QSEE reserved DMA heaps"
    select QCOM_DMABUF_HEAPS_CMA
    select QCOM_SECURE_BUFFER
```

## input381/input381/Kconfig
```kconfig
config TOUCHSCREEN_GOODIX_BRL
	tristate "Pong Goodix BRL LAB"
config TOUCHSCREEN_GOODIX_BRL_SPI
	bool "Pong Goodix SPI transport"
```

## kgsl71/Kconfig
```kconfig
# SPDX-License-Identifier: GPL-2.0-only
config QCOM_LLCC
 tristate
 default y
config QCOM_KGSL
 bool
 default y
config QCOM_MDT_LOADER
 tristate
 default y
config QCOM_KGSL_IDLE_TIMEOUT
 int
 default 80
config QCOM_KGSL_SORT_POOL
 bool
 default y
config QCOM_KGSL_CONTEXT_DEBUG
 bool
 default y
config QCOM_KGSL_IOCOHERENCY_DEFAULT
 bool
 default y
config QCOM_ADRENO_DEFAULT_GOVERNOR
 string
 default "msm-adreno-tz"

# Runtime memory providers are real modules, not disabled header fallbacks.
config QCOM_IOMMU_UTIL
 tristate
 default m
config QCOM_SECURE_BUFFER
 tristate
 default m
config QCOM_LAZY_MAPPING
 tristate
 default m

config QTI_IOMMU_SUPPORT
 bool
 default y

config IOMMU_IO_PGTABLE_FAST
 bool
 default y

config ARM_SMMU_CONTEXT_FAULT_RETRY
 bool
 default y

config PONG618_MEMBUF_EXPORTER
 tristate "Pong actual MEM-BUF exporter"
 select QCOM_MEM_BUF_DEV
```

## memBufCLS12/defconfig
```kconfig
CONFIG_GH_ARM64_DRV=m
CONFIG_GH_MSGQ=m
CONFIG_GH_DBL=m
CONFIG_GH_RM_DRV=m
CONFIG_GH_MEM_NOTIFIER=m
CONFIG_GH_GUEST_POPS=y
CONFIG_QCOM_MEM_BUF_DEV=m
CONFIG_QCOM_MEM_BUF_DEV_GH=y
CONFIG_QCOM_MEM_BUF=m
CONFIG_QCOM_MEM_BUF_GH=y
CONFIG_QCOM_MEM_BUF_MSGQ=m
# CONFIG_QCOM_MEM_BUF_IPA_RESERVE is not set
```

## membuf158/Kconfig
```kconfig
# SPDX-License-Identifier: GPL-2.0-only
config GH_ARM64_DRV
 tristate
 default m
config GH_MSGQ
 tristate
 default m
config GH_DBL
 tristate
 default m
config GH_RM_DRV
 tristate
 default m
config GH_MEM_NOTIFIER
 tristate
 default m
config GH_GUEST_POPS
 bool
 default y
```

## memory/Kconfig
```kconfig
# SPDX-License-Identifier: GPL-2.0-only
config QCOM_IOMMU_UTIL
    tristate
config QCOM_IOMMU_DEBUG
    tristate
config QTI_IOMMU_SUPPORT
    bool
config IOMMU_IO_PGTABLE_FAST
    bool
config QCOM_LAZY_MAPPING
    tristate
config QCOM_SECURE_BUFFER
    tristate
config ARM_SMMU_CONTEXT_FAULT_RETRY
    bool
config PONG618_VENDOR_MEMORY
    tristate "Pong complete vendor SMMU and memory batch"
    select ARM_SMMU
    select ARM_SMMU_QCOM
    select QCOM_SCM
    select QCOM_IOMMU_UTIL
    select QCOM_IOMMU_DEBUG
    select QTI_IOMMU_SUPPORT
    select IOMMU_IO_PGTABLE_FAST
    select QCOM_LAZY_MAPPING
    select QCOM_SECURE_BUFFER
    select ARM_SMMU_CONTEXT_FAULT_RETRY
```
