## platform/Kconfig
```kconfig
# SPDX-License-Identifier: GPL-2.0-only
config PONG618_PLATFORM_BATCH
    tristate "Pong clocks, pinctrl and interconnect host batch"
    select COMMON_CLK_QCOM
    select SM_GCC_8450
    select QCOM_CLK_RPMH
    select INTERCONNECT_CLK
    select QCOM_SCM
    select QCOM_SMEM
    select QCOM_RPMH
    select QCOM_COMMAND_DB
    select PINCTRL_MSM
    select QCOM_SOCINFO
    select QCOM_PDC
    select INTERCONNECT_QCOM_RPMH
    select ARM_SMMU
    select ARM_SMMU_QCOM
```

## power-closure/Kconfig
```kconfig
config USB_REDRIVER
    tristate
config PONG618_POWER_CLOSURE
    tristate "Pong power and lifecycle closure"
    select USB_REDRIVER
    select SM_GCC_8450
```

## power-consumers29/Kconfig
```kconfig
# SPDX-License-Identifier: GPL-2.0-only
config REGULATOR_RPMH
    tristate
config REGULATOR_DEBUG_CONTROL
    tristate
config REGULATOR_PROXY_CONSUMER
    tristate
config REGULATOR_QTI_FIXED_VOLTAGE
    tristate
config QCOM_GDSC_REGULATOR
    tristate
config USB_REPEATER
    tristate
config PONG618_POWER_IO
    tristate "Pong power and physical IO batch"
    select SPMI_MSM_PMIC_ARB
    select MFD_SPMI_PMIC
    select PINCTRL_QCOM_SPMI_PMIC
    select PINCTRL_QCOM_SSBI_PMIC
    select NVMEM_SPMI_SDAM
    select QCOM_COMMAND_DB
    select QCOM_RPMH
    select REGULATOR_RPMH
    select REGULATOR_DEBUG_CONTROL
    select REGULATOR_PROXY_CONSUMER
    select REGULATOR_QTI_FIXED_VOLTAGE
    select QCOM_GDSC_REGULATOR
    select USB_REPEATER
    select SCSI_UFS_QCOM
    select QCOM_INLINE_CRYPTO_ENGINE
```

## providers67/Kconfig
```kconfig
# SPDX-License-Identifier: GPL-2.0-only
config QCOM_PANEL_EVENT_NOTIFIER
	bool
	default y
```

## qrtr516/Kconfig
```kconfig
config QRTR_MHI
	tristate "Matching MHI QRTR transport"
config MHI_BUS
	tristate "Matching external MHI provider"
```

## rpmh-native25/Kconfig
```kconfig
# SPDX-License-Identifier: GPL-2.0-only
config PONG618_RPMH_NATIVE25
    tristate "Pong native multi-DRV RPMh port"
    select QCOM_COMMAND_DB
    select QCOM_RPMH

config QCOM_RPMH_TIMEOUT
    int "Timeout for RPMh communication in milliseconds"
    default 5000
    depends on QCOM_RPMH
```

## secure256/Kconfig
```kconfig
config QSEECOM
    bool
config QCOM_SMCINVOKE
    bool
config QTEE_SHM_BRIDGE
    bool
config MEM_BUF
    tristate
config PONG_SECURE256
    tristate "Pong SMCI and QSEE"
    select HDCP_QSEECOM
    select QSEECOM
    select QCOM_SMCINVOKE
    select QTEE_SHM_BRIDGE
    select MEM_BUF
    select QCOM_SCM
    select QCOM_TZMEM

config HDCP_QSEECOM
    bool
```

## secure256/defconfig
```kconfig
CONFIG_PONG_SECURE256=m
CONFIG_QSEECOM=y
CONFIG_QCOM_SMCINVOKE=y
CONFIG_QTEE_SHM_BRIDGE=y
CONFIG_MEM_BUF=m
CONFIG_QCOM_TZMEM_MODE_SHMBRIDGE=y
# CONFIG_QCOM_TZMEM_MODE_GENERIC is not set
```

## secure256/scm/defconfig
```kconfig
CONFIG_PONG618_VENDOR_FOUNDATION=m
CONFIG_QCOM_TZMEM_MODE_SHMBRIDGE=y
# CONFIG_QCOM_TZMEM_MODE_GENERIC is not set
# CONFIG_QCOM_TZMEM_FFA is not set
# CONFIG_QCOM_TZMEM_LOW_MEMORY is not set
```

## subsystems407/defconfig
```kconfig
CONFIG_QCOM_Q6V5_COMMON=m
CONFIG_QCOM_Q6V5_PAS=m
CONFIG_QCOM_RPROC_COMMON=m
CONFIG_QCOM_SYSMON=m
CONFIG_QCOM_PIL_INFO=m
CONFIG_QCOM_RAMDUMP=m
CONFIG_RPMSG_QCOM_GLINK=m
CONFIG_RPMSG_QCOM_GLINK_SMEM=m
CONFIG_QCOM_PDR_HELPERS=m
CONFIG_QCOM_QMI_HELPERS=m
CONFIG_QTI_PMIC_GLINK=m
CONFIG_QTI_BATTERY_CHARGER=m
CONFIG_BT_POWER=m
CONFIG_CNSS2=m
CONFIG_CNSS2_QMI=y
CONFIG_CNSS_OUT_OF_TREE=y
CONFIG_CNSS_UTILS=m
# CONFIG_RPMSG_QCOM_SMD is not set
CONFIG_PCI_MSM=m
CONFIG_MHI_BUF_LEN=16384
CONFIG_CNSS_QMI_SVC=m
CONFIG_CNSS_PLAT_IPC_QMI_SVC=m

CONFIG_PONG618_VENDOR_FOUNDATION=m
CONFIG_QCOM_TZMEM_MODE_SHMBRIDGE=y
# CONFIG_QCOM_TZMEM_MODE_GENERIC is not set
# CONFIG_QCOM_TZMEM_FFA is not set
# CONFIG_QCOM_TZMEM_LOW_MEMORY is not set

CONFIG_QCOM_MDT_LOADER=m
CONFIG_RPROC_SSR_NOTIF_TIMEOUT=20000
CONFIG_RPROC_SYSMON_NOTIF_TIMEOUT=20000
CONFIG_RPROC_SYSMON_SHUTDOWN_NOTIF_TIMEOUT=10000
CONFIG_PDR_INDICATION_NOTIF_TIMEOUT=9000
CONFIG_MHI_BUS=m
CONFIG_MHI_BUS_MISC=y
CONFIG_MHI_BUS_DEBUG=y
CONFIG_QRTR_SMD=m
```

## uart480/Kconfig
```kconfig
config SERIAL_MSM_GENI
	tristate "Pong HS UART"
config SERIAL_MSM_GENI_CONSOLE
	bool "Pong serial console"
```

## ufs-return37/Kconfig
```kconfig
config PONG618_PROBE_GATE
    tristate "Pong clock load-policy fix"
    select SM_GCC_8450
```

## usb-diag31/Kconfig
```kconfig
# SPDX-License-Identifier: GPL-2.0-only
config MSM_GPI_DMA
    tristate
config USB_REDRIVER
    tristate
config USB_REPEATER
    tristate
config PONG618_INTEGRATION
    tristate "Pong USB I2C DMA UFS integration"
    select MSM_GPI_DMA
    select USB_REDRIVER
    select USB_REPEATER
    select SCSI_UFS_QCOM
    select QCOM_INLINE_CRYPTO_ENGINE
```

## wlan452/platform/Kconfig.pong452
```kconfig
config CNSS_OUT_OF_TREE
	bool "CNSS external headers"
config WCNSS_MEM_PRE_ALLOC
	tristate "CNSS memory pools"
config CNSS_GENL
	tristate "CNSS netlink"
```
